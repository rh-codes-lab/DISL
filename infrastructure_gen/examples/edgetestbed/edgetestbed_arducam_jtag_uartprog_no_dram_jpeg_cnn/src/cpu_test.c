#include <stdarg.h> 
#include <stdint.h>
#include <stddef.h>
#include "utils.h"
#include "arducam_ov2640.h"
 
void quantize(int8_t* output);
void convolution2D(int8_t* input,int8_t* output);
void maxPooling2D(int8_t* input, int8_t* output);
void fullyConnected(int8_t* input, int8_t* output);

#define IMAGE_HEIGHT 240
#define IMAGE_WIDTH 40
#define IMAGE_CHANNELS 1
#define FILTER_HEIGHT 3
#define FILTER_WIDTH 3
#define FILTER_CHANNELS 1
#define CONV_STRIDE 1
#define POOL_SIZE 2
#define NUM_CLASSES 2

#define IMAGE_SIZE IMAGE_HEIGHT*IMAGE_WIDTH
#define CONV_OUTPUT_HEIGHT ((IMAGE_HEIGHT - FILTER_HEIGHT) / CONV_STRIDE + 1)
#define CONV_OUTPUT_WIDTH ((IMAGE_WIDTH - FILTER_WIDTH) / CONV_STRIDE + 1)
#define POOL_OUTPUT_HEIGHT (CONV_OUTPUT_HEIGHT / POOL_SIZE)
#define POOL_OUTPUT_WIDTH (CONV_OUTPUT_WIDTH / POOL_SIZE)
#define FC_PARAMETERS_PER_CLASS POOL_OUTPUT_HEIGHT*POOL_OUTPUT_WIDTH

const int8_t fc_weights[] = {4,-9,-87,29,-91,-52,-80,-75,-39,35,-112,-91,-25,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90,-52};
const int32_t fc_biases[] = {-677,665};
const int8_t conv_filter[] = {-71, 127, 82, -22, 60, -118, 29, -46, 87};
const int32_t conv_bias[] = { -2 };

int main( )    
{ 
  gpio = 0xFFFFFFFC; // turn off the LEDs  
  uint32_t threshold =20;    
  InitCAM(JPEG);
  clear_fifo_flag();
  write_reg(ARDUCHIP_FRAMES,0x00);
  set_Light_Mode(Office);
  set_Color_Saturation(Saturation0);  
  set_Brightness(Brightness0);
  set_Contrast(Contrast0);
  set_Special_effects(Normal);  
  set_JPEG_size(OV2640_320x240); 
  int8_t buf1[IMAGE_SIZE]; 
  int8_t buf2[IMAGE_SIZE];
  while(1){   
    capture(threshold);
    quantize(buf1);
    convolution2D(buf1,buf2); 
    maxPooling2D(buf2, buf1);
    fullyConnected(buf1, buf2);
    debug = ((int32_t)buf2[0])+128;
    debug = ((int32_t)buf2[1])+128;
    for (uint16_t row = 0; row < IMAGE_HEIGHT; row++){
      for (uint16_t col = 0; col < IMAGE_WIDTH; col++){
          debug = getFrameByte(row*IMAGE_WIDTH + col);
      } 
    }
    terminate(); 
  }
while(1); 
}    


void quantize(int8_t* output){
    for (uint8_t row = 0; row < IMAGE_HEIGHT; row++){
        for (uint8_t col = 0; col < IMAGE_WIDTH; col++){
            uint32_t index = row*IMAGE_WIDTH + col;
            uint32_t b = getFrameByte(index);
            int32_t b2 = b - 128;
            output[index] = (int8_t) b2;
        }
    }
}

void convolution2D(int8_t* input,int8_t* output) {
    for (int oy = 0; oy < CONV_OUTPUT_HEIGHT; oy++) {
        for (int ox = 0; ox < CONV_OUTPUT_WIDTH; ox++) {
            int32_t conv_result = conv_bias[0];
            int32_t one = 1;
            int32_t zero = 0;
            for (int fy = 0; fy < FILTER_HEIGHT; fy++) {
                for (int fx = 0; fx < FILTER_WIDTH; fx++) {
                    for (int c = 0; c < IMAGE_CHANNELS; c++) {
                        int iy = oy * CONV_STRIDE + fy;
                        int ix = ox * CONV_STRIDE + fx;
                        int8_t input_value = input[iy * (IMAGE_WIDTH * IMAGE_CHANNELS) + ix * IMAGE_CHANNELS + c];
                        int8_t filter_value = conv_filter[fy * (FILTER_WIDTH * FILTER_CHANNELS) + fx * FILTER_CHANNELS + c];
                        conv_result += (int32_t)input_value * (int32_t)filter_value;
                    }
                }
            }
            if (conv_result < 0) {
                conv_result = 0;
            } else if (conv_result > 127) {
                conv_result = 127;
            }
            output[oy * (CONV_OUTPUT_WIDTH * IMAGE_CHANNELS) + ox * IMAGE_CHANNELS] = (int8_t)conv_result;
        }
    }
}


void maxPooling2D(int8_t* input, int8_t* output) {
    for (int oy = 0; oy < POOL_OUTPUT_HEIGHT; oy++) {
        for (int ox = 0; ox < POOL_OUTPUT_WIDTH; ox++) {
            int8_t max_value = input[(oy * POOL_SIZE) * (CONV_OUTPUT_WIDTH * IMAGE_CHANNELS) + (ox * POOL_SIZE) * IMAGE_CHANNELS];
            for (int py = 0; py < POOL_SIZE; py++) {
                for (int px = 0; px < POOL_SIZE; px++) {
                    for (int c = 0; c < IMAGE_CHANNELS; c++) {
                        int iy = oy * POOL_SIZE + py;
                        int ix = ox * POOL_SIZE + px;
                        int8_t input_value = input[iy * (CONV_OUTPUT_WIDTH * IMAGE_CHANNELS) + ix * IMAGE_CHANNELS + c];
                        if (input_value > max_value) {
                            max_value = input_value;
                        }
                    }
                }
            }
            output[oy * (POOL_OUTPUT_WIDTH * IMAGE_CHANNELS) + ox * IMAGE_CHANNELS] = max_value;
        }
    }
}

void fullyConnected(int8_t* input, int8_t* output) {
    for (int o = 0; o < NUM_CLASSES; o++) {
        int32_t fc_result = fc_biases[o];
        int32_t one = 1;
        int32_t zero = 0;
        for (int i = 0; i < FC_PARAMETERS_PER_CLASS; i++) {
            int32_t input_value = input[i];
            int32_t weight_value = fc_weights[o * FC_PARAMETERS_PER_CLASS + i];
            fc_result += (int32_t)input_value * (int32_t)weight_value;
        }
        if (fc_result < -128) {
            fc_result = -128;
        } else if (fc_result > 127) {
            fc_result = 127;
        }
        output[o] = (int8_t)fc_result;
    }
}